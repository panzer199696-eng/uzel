// Дерево устройств УЗЛА поверх платы xiao_ble/nrf52840/sense.
// Из оверлея Omi DK2 убраны SD-карта (spi2), динамик (i2s0) и IMU (i2c0):
// в нашем железе их нет или они пока не используются. Микрофон PDM работает
// через nrfx напрямую (src/mic.c), узел в дереве ему не нужен.

&uart0 {
    status = "disabled";
};

&i2c1 {
    status = "disabled";
};

&temp {
    status = "disabled";
};
